## config/west.yml
```yaml
# DYA Studio (https://github.com/cormoran/dya-studio) 対応のためのマニフェスト
# cormoran 版 ZMK (main+dya) と関連モジュールを使用する
manifest:
  version: 1.2
  defaults:
    remote: cormoran
    revision: main
  remotes:
    - name: cormoran
      url-base: https://github.com/cormoran
    - name: zmkfirmware
      url-base: https://github.com/zmkfirmware
    - name: prospector
      url-base: https://github.com/t-ogura
  projects:
    - name: zmk
      import:
        file: app/west.yml
      clone-depth: 1
      revision: main+dya
    - name: zephyr
      revision: v4.1.0+zmk-fixes+nrf-half-duplex-uart
      clone-depth: 1
      import:
        name-blocklist:
          - ci-tools
          - hal_altera
          - hal_cypress
          - hal_infineon
          - hal_microchip
          - hal_nxp
          - hal_openisa
          - hal_silabs
          - hal_xtensa
          - hal_st
          - hal_ti
          - loramac-node
          - mcuboot
          - mcumgr
          - net-tools
          - openthread
          - edtt
          - trusted-firmware-m
    # PMW3610 ドライバ (DYA Studio 用のカスタム Studio RPC 付き)
    - name: zmk-driver-pmw3610-with-custom-studio-rpc
    - name: zmk-feature-os-detection
    - name: zmk-feature-default-layer
      revision: codex/custom-rpc-rewrite
      import: true
    - name: zmk-module-ble-management
    - name: zmk-module-battery-history
    - name: zmk-module-runtime-input-processor
    - name: zmk-behavior-runtime-sensor-rotate
      revision: feat/custom-settings-storage
    - name: zmk-module-settings-rpc
    - name: zmk-feature-input-stream
    - name: zmk-feature-module-physical-layout
    - name: zmk-feature-custom-settings
    - name: zmk-feature-runtime-combo
    - name: zmk-feature-runtime-macro
    - name: zmk-module-devtool
    - name: zmk-feature-studio-rpc-perf
    - name: zmk-feature-zephyr-setting-expose
    - name: zmk-feature-device-info
    - name: zmk-feature-watchdog
    - name: zmk-feature-fast-keymap
    # Prospector 対応
    - name: prospector-zmk-module
      remote: prospector
      revision: v2.2.1
      path: modules/prospector-zmk-module
  self:
    path: config
```
